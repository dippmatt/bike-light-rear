## CMakeLists.txt
```
cmake_minimum_required(VERSION 3.20.0)
find_package(Zephyr REQUIRED HINTS $ENV{ZEPHYR_BASE})

project(front_light_central)

# Option to enable debug features (I2C scanner and debug prints)
option(DEBUG "Enable debug features (I2C scanner and debug prints)" ON)

target_sources(app PRIVATE 
    src/main.c
    src/sensor_data_collector.c
    src/button.c
    src/light_modes.c
    src/main_state_machine.c
    src/power_management.c
    src/ble_central.c
)

# Conditionally enable debug features
if(DEBUG)
    target_sources(app PRIVATE 
        src/i2c_scanner.c
    )
    target_compile_definitions(app PRIVATE 
        DEBUG=1
    )
endif()

target_include_directories(app PRIVATE
    inc/
)


target_compile_options(app PRIVATE
    -Wall
    -Wextra
    -Werror
)
```

## prj.conf
```kconfig
# Enable device power management and system poweroff
CONFIG_PM_DEVICE=y
CONFIG_POWEROFF=y

# Enable logging
CONFIG_LOG=y
CONFIG_LOG_DEFAULT_LEVEL=3
CONFIG_LOG_MODE_IMMEDIATE=y

# Debug/fault diagnostics
CONFIG_ASSERT=y
CONFIG_FAULT_DUMP=2
CONFIG_THREAD_NAME=y
CONFIG_THREAD_STACK_INFO=y
CONFIG_STACK_SENTINEL=y
CONFIG_INIT_STACKS=y

# Enalble POSIX API for read-write locks
CONFIG_POSIX_API=y

# Enable console and RTT output
CONFIG_CONSOLE=y
CONFIG_RTT_CONSOLE=y
CONFIG_USE_SEGGER_RTT=y

# Enable GPIO
CONFIG_GPIO=y

# Enable ADC
CONFIG_ADC=y
CONFIG_ADC_NRFX_SAADC=y

# Enable PWM
CONFIG_PWM=y

# Enable work queue for button processing
CONFIG_SYSTEM_WORKQUEUE_STACK_SIZE=2048

# Enable I2C
CONFIG_I2C=y

# Enable sensors drivers
CONFIG_SENSOR=y
CONFIG_TEMP_NRF5=y
CONFIG_OPT3001=y

# Enable clock control (required for temperature sensor)
CONFIG_CLOCK_CONTROL=y
CONFIG_CLOCK_CONTROL_NRF=y
CONFIG_CLOCK_CONTROL_NRF_K32SRC_RC=y

# bluetooth settings
CONFIG_BT=y
CONFIG_BT_CENTRAL=y
CONFIG_BT_OBSERVER=y
CONFIG_BT_SMP=y
CONFIG_BT_GATT_CLIENT=y

CONFIG_BT_BUF_ACL_RX_SIZE=255
CONFIG_BT_BUF_ACL_TX_SIZE=251
CONFIG_BT_BUF_CMD_TX_SIZE=255
CONFIG_BT_BUF_EVT_DISCARDABLE_SIZE=255

CONFIG_BT_L2CAP_TX_MTU=247
```

## src/main.c
```c
/*
 * Copyright (c) 2025 Matthias Dippold
 *
 * This program is free software: you can redistribute it and/or modify
 * it under the terms of the GNU General Public License as published by
 * the Free Software Foundation, either version 3 of the License, or
 * (at your option) any later version.
 *
 * This program is distributed in the hope that it will be useful,
 * but WITHOUT ANY WARRANTY; without even the implied warranty of
 * MERCHANTABILITY or FITNESS FOR A PARTICULAR PURPOSE.  See the
 * GNU General Public License for more details.
 *
 * You should have received a copy of the GNU General Public License
 * along with this program.  If not, see <https://www.gnu.org/licenses/>.
 *
 * NON-COMMERCIAL USE CLAUSE:
 * Permission is granted to use, copy, modify, and distribute this software
 * and its derivatives for NON-COMMERCIAL purposes only. Commercial use of
 * this software, in whole or in part, is strictly prohibited without
 * explicit written permission from the copyright holder.
 */

#include <zephyr/kernel.h>
#include <zephyr/drivers/gpio.h>
#include <zephyr/devicetree.h>
#include <zephyr/pm/device.h>
#include <zephyr/sys/poweroff.h>

#include "utils.h"
#include "button.h"
#include "main_state_machine.h"
#include "sensor_data_collector.h"
#include "power_management.h"
#include "ble_central.h"
#ifdef DEBUG
#include "i2c_scanner.h"
#endif

/* Global sensor buffer and environmental state */
sensor_buffer_t g_sensor_buffer;
environmental_state_t g_env_state;

static void button_event_handler(enum button_press_type press_type)
{
    ARG_UNUSED(press_type);
    
    /* Advance state machine on button press.
     * Note: the actual state transition happens asynchronously via k_work
     * in main_state_machine_on_button_press, so we cannot immediately check
     * the new state here. Sleep/poweroff is not used on the front light central. */
    main_state_machine_on_button_press();
}

int main(void)
{
    int ret;
    
    debug_printk("System starting...\n");
    
    /* Initialize global sensor buffer */
    pthread_rwlock_init(&g_sensor_buffer.lock, NULL);
    g_sensor_buffer.write_index = 0;
    
    /* Initialize environmental state to safe defaults */
    g_env_state.is_braking = false;
    g_env_state.ambient_dark = false;
    g_env_state.previous_brightness = 0;
    
    /* Initialize main state machine (LED control) */
    ret = main_state_machine_init();
    if (ret != 0) {
        /* State machine initialization failed */
        return -1;
    }
    
    /* Initialize Bluetooth Low Energy */
    ret = bluetooth_init();
    if (ret != 0) {
        debug_printk("BLE Init failed: %d\n", ret);
        /* Continue anyway - BLE is optional */
    } else {
        debug_printk("BLE initialized successfully\n");
    }
    debug_printk("Statement after BLE initialization\n");
    
    /* Initialize button GPIO (but don't enable interrupts yet) */
    int err = -1;
    err = button_init(button_event_handler);
	if (err) {
		debug_printk("Button Init failed: %d\n", err);
		return err;
	}
	debug_printk("Button GPIO configured (interrupts not yet enabled)...\n");
    
#ifdef DEBUG
    /* Scan I2C bus for debugging */
    const struct device *const i2c_dev = DEVICE_DT_GET(DT_NODELABEL(i2c0));
    if (i2c_dev != NULL && device_is_ready(i2c_dev)) {
        debug_printk("Scanning I2C bus during initialization...\n");
        scan_i2c_bus(i2c_dev);
    } else {
        debug_printk("I2C bus not available for scanning\n");
    }
#endif
    
    /* Enable button interrupts AFTER slow initialization tasks
     * This prevents spurious button events during I2C scanning and other init */
    err = button_enable_interrupts();
    if (err) {
        debug_printk("Button interrupt enable failed: %d\n", err);
        return err;
    }
    debug_printk("Button interrupts enabled. Ready for events...\n");
    
    /* Main loop (only reached if NOT in LED_OFF state) */
    while (1) {
        /* Sleep to save power - timers and interrupts will wake the CPU */
        k_msleep(1000);
    }

    return 0;
}
```

## inc/ble_central.h
```c
#ifndef BLE_CENTRAL_H
#define BLE_CENTRAL_H

#include <stdint.h>

int bluetooth_init(void);
void ble_central_send_control(uint8_t value);

#endif /* BLE_CENTRAL_H */
```

## inc/button.h
```c
/*
 * Copyright (c) 2025 Matthias Dippold
 *
 * This program is free software: you can redistribute it and/or modify
 * it under the terms of the GNU General Public License as published by
 * the Free Software Foundation, either version 3 of the License, or
 * (at your option) any later version.
 *
 * This program is distributed in the hope that it will be useful,
 * but WITHOUT ANY WARRANTY; without even the implied warranty of
 * MERCHANTABILITY or FITNESS FOR A PARTICULAR PURPOSE.  See the
 * GNU General Public License for more details.
 *
 * You should have received a copy of the GNU General Public License
 * along with this program.  If not, see <https://www.gnu.org/licenses/>.
 *
 * NON-COMMERCIAL USE CLAUSE:
 * Permission is granted to use, copy, modify, and distribute this software
 * and its derivatives for NON-COMMERCIAL purposes only. Commercial use of
 * this software, in whole or in part, is strictly prohibited without
 * explicit written permission from the copyright holder.
 */

 #ifndef _BUTTON_H_
 #define _BUTTON_H_
 
 enum button_press_type {
     BUTTON_PRESS_SHORT,
     BUTTON_PRESS_LONG
 };
 
 typedef void (*button_event_handler_t)(enum button_press_type press_type);
 
 int button_init(button_event_handler_t handler);
 int button_enable_interrupts(void);
 int button_configure_wakeup(void);
 
 #endif /* _BUTTON_H_ */
```

## inc/light_modes.h
```c
/*
 * Copyright (c) 2025 Matthias Dippold
 *
 * This program is free software: you can redistribute it and/or modify
 * it under the terms of the GNU General Public License as published by
 * the Free Software Foundation, either version 3 of the License, or
 * (at your option) any later version.
 *
 * This program is distributed in the hope that it will be useful,
 * but WITHOUT ANY WARRANTY; without even the implied warranty of
 * MERCHANTABILITY or FITNESS FOR A PARTICULAR PURPOSE.  See the
 * GNU General Public License for more details.
 *
 * You should have received a copy of the GNU General Public License
 * along with this program.  If not, see <https://www.gnu.org/licenses/>.
 *
 * NON-COMMERCIAL USE CLAUSE:
 * Permission is granted to use, copy, modify, and distribute this software
 * and its derivatives for NON-COMMERCIAL purposes only. Commercial use of
 * this software, in whole or in part, is strictly prohibited without
 * explicit written permission from the copyright holder.
 */

#ifndef LIGHT_MODES_H
#define LIGHT_MODES_H

#include <stdint.h>
#include <stdbool.h>
#include <zephyr/kernel.h>

/**
 * @brief LED state machine states
 */
enum system_state {
    LED_OFF = 0,     /* 0% duty cycle */
    LED_50_PERCENT,  /* 50% duty cycle */
    LED_50_80_FLASH, /* High visibility mode: 50% with periodic 80% flashes */
    LED_SMART_MODE   /* Smart mode: adaptive brightness based on braking and ambient light */
};

/** @brief Timer expiry callback for the flash timer */
void flash_timer_expiry(struct k_timer *timer);

/** @brief Timer expiry callback for the blink timer */
void blink_timer_expiry(struct k_timer *timer);

/** @brief Timer expiry callback for the status LED timer */
void status_led_timer_expiry(struct k_timer *timer);

/**
 * @brief Initialize PWM LED hardware
 * 
 * Configures PWM device and sets LED to off state.
 * 
 * @return 0 on success, negative error code on failure
 */
int flash_timers_init(void);

/**
 * @brief Initialize Status LED GPIO
 * 
 * Initializes and starts the timer for the STATUS LED.
 * 
 * @return 0 on success, negative error code on failure
 */
int status_led_init(void);

/**
 * @brief Stop any active blinking mode
 * Sets LED brightness to 0% (off).
 */
void light_modes_stop_blinking(void);

/**
 * @brief Set LED brightness to 50%
 * Stops any active blinking mode.
 */
void light_modes_set_50_percent(void);

/**
 * @brief Set LED to high visibility blinking mode
 * 
 * LED runs at 50% duty cycle normally, and flashes to 80% for 100ms every second.
 */
void light_modes_set_100_percent(void);

/**
 * @brief Initialize SMART_MODE
 * 
 * Sets LED to initial state for SMART_MODE operation.
 * Actual brightness is controlled by environmental conditions.
 */
void light_modes_set_smart_mode(void);

/**
 * @brief Update PWM in SMART_MODE based on environmental state
 * 
 * Should be called when environmental conditions change (braking, ambient light).
 * Reads global environmental state and adjusts PWM accordingly.
 */
void light_modes_update_smart_pwm(void);

/**
 * @brief Get current PWM pulse width
 * 
 * @return Current PWM pulse width in microseconds
 */
uint32_t light_modes_get_current_pwm(void);

/**
 * @brief Set main LED to off
 * 
 * Sets LED PWM to 0% duty cycle.
 */
void light_modes_off_main_led(void);

/**
 * @brief Start the status LED timer
 * 
 * Starts the periodic timer that blinks the status LED.
 */
void light_modes_start_status_led(void);

/**
 * @brief Stop the status LED timer
 * 
 * Stops the status LED timer and turns off the LED.
 */
void light_modes_stop_status_led(void);

#endif /* LIGHT_MODES_H */
```

## inc/main_state_machine.h
```c
/*
 * Copyright (c) 2025 Matthias Dippold
 *
 * This program is free software: you can redistribute it and/or modify
 * it under the terms of the GNU General Public License as published by
 * the Free Software Foundation, either version 3 of the License, or
 * (at your option) any later version.
 *
 * This program is distributed in the hope that it will be useful,
 * but WITHOUT ANY WARRANTY; without even the implied warranty of
 * MERCHANTABILITY or FITNESS FOR A PARTICULAR PURPOSE.  See the
 * GNU General Public License for more details.
 *
 * You should have received a copy of the GNU General Public License
 * along with this program.  If not, see <https://www.gnu.org/licenses/>.
 *
 * NON-COMMERCIAL USE CLAUSE:
 * Permission is granted to use, copy, modify, and distribute this software
 * and its derivatives for NON-COMMERCIAL purposes only. Commercial use of
 * this software, in whole or in part, is strictly prohibited without
 * explicit written permission from the copyright holder.
 */

#ifndef MAIN_STATE_MACHINE_H
#define MAIN_STATE_MACHINE_H

#include "light_modes.h"

/**
 * @brief Initialize the main state machine
 * 
 * Sets up the state machine and connects button and LED control.
 * 
 * @return 0 on success, negative error code on failure
 */
int main_state_machine_init(void);

/**
 * @brief Handle button press event
 * 
 * Called by button module when a button press is detected.
 * This function cycles through LED brightness states.
 */
void main_state_machine_on_button_press(void);

/**
 * @brief Automatically turn off LED
 * 
 * Called by stationary monitor when device has been stationary for too long.
 * Only acts if current state is SMART_MODE.
 * 
 */
void main_state_machine_auto_off(void);

/**
 * @brief Get current LED state
 * 
 * @return Current LED brightness state
 */
enum system_state main_state_machine_get_state(void);

/**
 * @brief Get timestamp (ms) of last state transition
 */
int64_t main_state_machine_last_change_ms(void);

/**
 * @brief Peek next state without mutating the state machine
 *
 * @return Next state according to the normal cycle
 */

/**
 * @brief Set LED state directly (for external control, e.g., BLE)
 * 
 * Allows external modules to directly set the LED state.
 * This bypasses the normal button press cycle.
 * 
 * @param new_state The state to transition to
 * @return 0 on success, negative error code on failure
 */
int main_state_machine_set_state(enum system_state new_state);

/* Global LED state */
extern enum system_state g_system_state;

#endif /* MAIN_STATE_MACHINE_H */
```

## inc/power_management.h
```c
/*
 * Copyright (c) 2025 Matthias Dippold
 *
 * This program is free software: you can redistribute it and/or modify
 * it under the terms of the GNU General Public License as published by
 * the Free Software Foundation, either version 3 of the License, or
 * (at your option) any later version.
 *
 * This program is distributed in the hope that it will be useful,
 * but WITHOUT ANY WARRANTY; without even the implied warranty of
 * MERCHANTABILITY or FITNESS FOR A PARTICULAR PURPOSE.  See the
 * GNU General Public License for more details.
 *
 * You should have received a copy of the GNU General Public License
 * along with this program.  If not, see <https://www.gnu.org/licenses/>.
 *
 * NON-COMMERCIAL USE CLAUSE:
 * Permission is granted to use, copy, modify, and distribute this software
 * and its derivatives for NON-COMMERCIAL purposes only. Commercial use of
 * this software, in whole or in part, is strictly prohibited without
 * explicit written permission from the copyright holder.
 */

#ifndef POWER_MANAGEMENT_H
#define POWER_MANAGEMENT_H

/**
 * @brief Enter system off (deep sleep) mode
 * 
 * Prepares the system for low-power system off mode and enters it.
 * The system will wake on button press (configured as wake source).
 * Note: System off is like a reset - upon wake, execution starts from main().
 */
void power_management_enter_sleep(void);

#endif /* POWER_MANAGEMENT_H */
```

## inc/utils.h
```c
/*
 * Copyright (c) 2025 Matthias Dippold
 *
 * This program is free software: you can redistribute it and/or modify
 * it under the terms of the GNU General Public License as published by
 * the Free Software Foundation, either version 3 of the License, or
 * (at your option) any later version.
 *
 * This program is distributed in the hope that it will be useful,
 * but WITHOUT ANY WARRANTY; without even the implied warranty of
 * MERCHANTABILITY or FITNESS FOR A PARTICULAR PURPOSE.  See the
 * GNU General Public License for more details.
 *
 * You should have received a copy of the GNU General Public License
 * along with this program.  If not, see <https://www.gnu.org/licenses/>.
 *
 * NON-COMMERCIAL USE CLAUSE:
 * Permission is granted to use, copy, modify, and distribute this software
 * and its derivatives for NON-COMMERCIAL purposes only. Commercial use of
 * this software, in whole or in part, is strictly prohibited without
 * explicit written permission from the copyright holder.
 */

#ifndef UTILS_H
#define UTILS_H

#include <zephyr/kernel.h>

/**
 * @brief Debug print function that conditionally uses printk
 * 
 * When DEBUG is enabled, this function behaves like printk().
 * When DEBUG is disabled, this function does nothing (no code generated).
 * 
 * Usage: debug_printk("format string", args...)
 */
#ifdef DEBUG
#define debug_printk(...) printk(__VA_ARGS__)
#else
#define debug_printk(...) ((void)0)
#endif

#endif /* UTILS_H */
```

## src/ble_central.c
```c
#include <zephyr/kernel.h>
#include <zephyr/sys/printk.h>
#include <zephyr/sys/byteorder.h>
#include <zephyr/sys/atomic.h>

#include <zephyr/bluetooth/bluetooth.h>
#include <zephyr/bluetooth/conn.h>
#include <zephyr/bluetooth/gatt.h>
#include <zephyr/bluetooth/hci.h>
#include <zephyr/bluetooth/uuid.h>

#include "ble_central.h"
#include "main_state_machine.h"

#define BLE_SERVICE_UUID       0xA000
#define BLE_LED_STATUS_UUID    0xA001
#define BLE_CONTROL_UUID       0xA002

static struct bt_conn *conn_connected;
static uint16_t svc_start_handle;
static uint16_t svc_end_handle;
static uint16_t led_status_handle;
static uint16_t control_handle;
static bool read_in_progress;
static bool read_ready;
static bool write_in_progress;
static bool discovery_in_progress;
static bool discovery_done;
static uint8_t last_led_status;
static bool state_synced;
static uint8_t stable_value;
static uint8_t stable_count;

#define STABLE_REQUIRED 3U
#define STABLE_WINDOW_MS 3000

static atomic_t manual_pending;
static uint8_t manual_value;

static struct bt_gatt_discover_params discover_params;
static struct bt_gatt_write_params write_params;
static struct bt_gatt_read_params read_params;

static void start_scan(void);
static void ble_tick(struct k_work *work);
K_WORK_DELAYABLE_DEFINE(ble_work, ble_tick);

void ble_central_send_control(uint8_t value)
{
	if (value > LED_SMART_MODE) {
		printk("Ignoring invalid control value: 0x%02x\n", value);
		return;
	}

	manual_value = value;
	atomic_set(&manual_pending, 1);
}

static bool ad_parse_cb(struct bt_data *data, void *user_data)
{
	bool *found = user_data;

	if (data->type != BT_DATA_UUID16_ALL &&
	    data->type != BT_DATA_UUID16_SOME) {
		return true;
	}

	for (size_t i = 0U; i + 1U < data->data_len; i += 2U) {
		uint16_t uuid16 = sys_get_le16(&data->data[i]);

		if (uuid16 == BLE_SERVICE_UUID) {
			*found = true;
			return false;
		}
	}

	return true;
}

static void device_found(const bt_addr_le_t *addr, int8_t rssi, uint8_t type,
			 struct net_buf_simple *ad)
{
	bool found = false;
	char addr_str[BT_ADDR_LE_STR_LEN];
	int err;

	if (conn_connected) {
		return;
	}

	if (type != BT_GAP_ADV_TYPE_ADV_IND &&
	    type != BT_GAP_ADV_TYPE_ADV_DIRECT_IND) {
		return;
	}

	bt_data_parse(ad, ad_parse_cb, &found);
	if (!found) {
		return;
	}

	bt_addr_le_to_str(addr, addr_str, sizeof(addr_str));
	printk("Found target: %s (RSSI %d)\n", addr_str, rssi);

	err = bt_le_scan_stop();
	if (err) {
		printk("Failed to stop scan (err %d)\n", err);
		return;
	}

	struct bt_conn *conn = NULL;

	err = bt_conn_le_create(addr, BT_CONN_LE_CREATE_CONN,
				BT_LE_CONN_PARAM_DEFAULT, &conn);
	if (err) {
		printk("Create conn failed (%d)\n", err);
		start_scan();
	} else {
		bt_conn_unref(conn);
	}
}

static void start_scan(void)
{
	int err;

	err = bt_le_scan_start(BT_LE_SCAN_ACTIVE, device_found);
	if (err) {
		printk("Scanning failed to start (err %d)\n", err);
		return;
	}

	printk("Scanning successfully started\n");
}

static void write_cb(struct bt_conn *conn, uint8_t err,
		     struct bt_gatt_write_params *params)
{
	ARG_UNUSED(conn);
	ARG_UNUSED(params);
	write_in_progress = false;

	if (err) {
		printk("Control write cb err %u\n", err);
		return;
	}

	printk("Control write cb ok\n");
}

static void write_control_value(struct bt_conn *conn, uint8_t value)
{
	static uint8_t control_value;
	int err;

	control_value = value;
	write_params.handle = control_handle;
	write_params.offset = 0U;
	write_params.data = &control_value;
	write_params.length = sizeof(control_value);
	write_params.func = write_cb;

	write_in_progress = true;
	err = bt_gatt_write(conn, &write_params);
	if (err) {
		write_in_progress = false;
		printk("Control write failed (err %d)\n", err);
	} else {
		printk("Control value written: 0x%02x\n", control_value);
	}
}

static uint8_t read_cb(struct bt_conn *conn, uint8_t err,
		       struct bt_gatt_read_params *params,
		       const void *data, uint16_t length)
{
	ARG_UNUSED(conn);
	ARG_UNUSED(params);
	read_in_progress = false;

	if (err) {
		printk("Read failed (err %u)\n", err);
		return BT_GATT_ITER_STOP;
	}

	if (!data) {
		return BT_GATT_ITER_STOP;
	}

	if (length >= sizeof(uint8_t)) {
		last_led_status = ((const uint8_t *)data)[0];
		read_ready = true;
	}

	return BT_GATT_ITER_STOP;
}

static uint8_t discover_char_cb(struct bt_conn *conn,
				const struct bt_gatt_attr *attr,
				struct bt_gatt_discover_params *params)
{
	ARG_UNUSED(params);
	ARG_UNUSED(conn);
	if (!attr) {
		if (led_status_handle && control_handle) {
			printk("Characteristics discovered\n");
			discovery_done = true;
		} else {
			printk("Characteristic discovery incomplete\n");
		}
		discovery_in_progress = false;
		return BT_GATT_ITER_STOP;
	}

	const struct bt_gatt_chrc *chrc = attr->user_data;

	if (!bt_uuid_cmp(chrc->uuid, BT_UUID_DECLARE_16(BLE_LED_STATUS_UUID))) {
		led_status_handle = chrc->value_handle;
		printk("LED status handle: 0x%04x\n", led_status_handle);
	} else if (!bt_uuid_cmp(chrc->uuid, BT_UUID_DECLARE_16(BLE_CONTROL_UUID))) {
		control_handle = chrc->value_handle;
		printk("Control handle: 0x%04x\n", control_handle);
	}

	return BT_GATT_ITER_CONTINUE;
}

static uint8_t discover_primary_cb(struct bt_conn *conn,
				   const struct bt_gatt_attr *attr,
				   struct bt_gatt_discover_params *params)
{
	ARG_UNUSED(params);
	int err;

	if (!attr) {
		printk("Service not found\n");
		discovery_in_progress = false;
		return BT_GATT_ITER_STOP;
	}

	const struct bt_gatt_service_val *service = attr->user_data;

	svc_start_handle = attr->handle + 1U;
	svc_end_handle = service->end_handle;

	discover_params.uuid = NULL;
	discover_params.start_handle = svc_start_handle;
	discover_params.end_handle = svc_end_handle;
	discover_params.type = BT_GATT_DISCOVER_CHARACTERISTIC;
	discover_params.func = discover_char_cb;

	err = bt_gatt_discover(conn, &discover_params);
	if (err) {
		printk("Char discover failed (err %d)\n", err);
		discovery_in_progress = false;
	}

	return BT_GATT_ITER_STOP;
}

static void discover_service(struct bt_conn *conn)
{
	int err;
	static struct bt_uuid_16 svc_uuid = BT_UUID_INIT_16(BLE_SERVICE_UUID);

	discover_params.uuid = &svc_uuid.uuid;
	discover_params.start_handle = BT_ATT_FIRST_ATTRIBUTE_HANDLE;
	discover_params.end_handle = BT_ATT_LAST_ATTRIBUTE_HANDLE;
	discover_params.type = BT_GATT_DISCOVER_PRIMARY;
	discover_params.func = discover_primary_cb;

	discovery_in_progress = true;
	discovery_done = false;
	err = bt_gatt_discover(conn, &discover_params);
	if (err) {
		printk("Service discover failed (err %d)\n", err);
		discovery_in_progress = false;
	}
}

static void connected(struct bt_conn *conn, uint8_t err)
{
	char addr[BT_ADDR_LE_STR_LEN];

	bt_addr_le_to_str(bt_conn_get_dst(conn), addr, sizeof(addr));

	if (err) {
		printk("Failed to connect to %s %u %s\n", addr, err, bt_hci_err_to_str(err));
		start_scan();
		return;
	}

	printk("Connected: %s\n", addr);
	conn_connected = bt_conn_ref(conn);
	discovery_in_progress = false;
	discovery_done = false;
}

static void disconnected(struct bt_conn *conn, uint8_t reason)
{
	char addr[BT_ADDR_LE_STR_LEN];

	if (conn != conn_connected) {
		return;
	}

	bt_addr_le_to_str(bt_conn_get_dst(conn), addr, sizeof(addr));
	printk("Disconnected: %s, reason 0x%02x %s\n", addr, reason, bt_hci_err_to_str(reason));

	bt_conn_unref(conn_connected);
	conn_connected = NULL;

	svc_start_handle = 0U;
	svc_end_handle = 0U;
	led_status_handle = 0U;
	control_handle = 0U;
	read_in_progress = false;
	read_ready = false;
	write_in_progress = false;
	discovery_in_progress = false;
	discovery_done = false;
	last_led_status = 0U;
	atomic_set(&manual_pending, 0);
	state_synced = false;
	stable_value = 0U;
	stable_count = 0U;

	start_scan();
}

BT_CONN_CB_DEFINE(conn_callbacks) = {
	.connected = connected,
	.disconnected = disconnected,
};

static void ble_tick(struct k_work *work)
{
	struct bt_conn *conn = NULL;
	ARG_UNUSED(work);

	if (conn_connected) {
		conn = bt_conn_ref(conn_connected);
	}

	if (conn) {
		if (!discovery_done && !discovery_in_progress) {
			discover_service(conn);
		} else if (discovery_done && led_status_handle && !read_in_progress) {
			int err;

			read_params.handle_count = 1U;
			read_params.single.handle = led_status_handle;
			read_params.single.offset = 0U;
			read_params.func = read_cb;

			read_in_progress = true;
			err = bt_gatt_read(conn, &read_params);
			if (err) {
				read_in_progress = false;
				printk("Read start failed (err %d)\n", err);
			}
		}

		if (read_ready) {
			read_ready = false;
			printk("LED status read: 0x%02x\n", last_led_status);

			if (last_led_status <= LED_SMART_MODE) {
				if (!state_synced) {
					main_state_machine_set_state(
						(enum system_state)last_led_status);
					state_synced = true;
					stable_value = last_led_status;
					stable_count = 1U;
				} else if (!atomic_get(&manual_pending)) {
					enum system_state current_state = main_state_machine_get_state();

					if (last_led_status == stable_value) {
						if (stable_count < UINT8_MAX) {
							stable_count++;
						}
					} else {
						stable_value = last_led_status;
						stable_count = 1U;
					}

					int64_t last_change = main_state_machine_last_change_ms();
					bool state_stable = (k_uptime_get() - last_change) >= STABLE_WINDOW_MS;

					if (state_stable && stable_count >= STABLE_REQUIRED &&
					    current_state != (enum system_state)last_led_status) {
						main_state_machine_set_state(
							(enum system_state)last_led_status);
					}
				}
			} else {
				printk("Ignoring invalid LED state: 0x%02x\n", last_led_status);
			}

			if (state_synced && atomic_get(&manual_pending)) {
				if (last_led_status == manual_value) {
					atomic_set(&manual_pending, 0);
				}
			}

			if (state_synced && control_handle && !write_in_progress) {
				enum system_state current_state = main_state_machine_get_state();

				if (current_state <= LED_SMART_MODE) {
					write_control_value(conn, (uint8_t)current_state);
				}
			}
		}

		bt_conn_unref(conn);
	}

	k_work_reschedule(&ble_work, K_SECONDS(1));
}

int bluetooth_init(void)
{
	int err;

	err = bt_enable(NULL);
	if (err) {
		printk("Bluetooth init failed (err %d)\n", err);
		return err;
	}

	printk("Bluetooth initialized\n");

	start_scan();
	k_work_schedule(&ble_work, K_NO_WAIT);

	return 0;
}
```

## src/bluetooth copy.c
```c
/*
 * Copyright (c) 2025 Matthias Dippold
 *
 * This program is free software: you can redistribute it and/or modify
 * it under the terms of the GNU General Public License as published by
 * the Free Software Foundation, either version 3 of the License, or
 * (at your option) any later version.
 *
 * This program is distributed in the hope that it will be useful,
 * but WITHOUT ANY WARRANTY; without even the implied warranty of
 * MERCHANTABILITY or FITNESS FOR A PARTICULAR PURPOSE.  See the
 * GNU General Public License for more details.
 *
 * You should have received a copy of the GNU General Public License
 * along with this program.  If not, see <https://www.gnu.org/licenses/>.
 *
 * NON-COMMERCIAL USE CLAUSE:
 * Permission is granted to use, copy, modify, and distribute this software
 * and its derivatives for NON-COMMERCIAL purposes only. Commercial use of
 * this software, in whole or in part, is strictly prohibited without
 * explicit written permission from the copyright holder.
 */

#include <zephyr/kernel.h>
#include <zephyr/bluetooth/bluetooth.h>
#include <zephyr/bluetooth/gatt.h>
#include <zephyr/bluetooth/conn.h>
#include <zephyr/bluetooth/uuid.h>
#include <zephyr/sys/util.h>
#include <string.h>

#include "bluetooth.h"
#include "main_state_machine.h"
#include "utils.h"

#ifdef BLUETOOTH
#ifndef BLE_MASTER
/* ========== SLAVE MODE IMPLEMENTATION ========== */

/* UUID definitions for slave mode */
static struct bt_uuid_128 button_service_uuid = BT_UUID_INIT_128(BT_UUID_BUTTON_SERVICE_VAL);
static struct bt_uuid_128 button_press_uuid = BT_UUID_INIT_128(
    BT_UUID_128_ENCODE(0x12345678, 0x1234, 0x5678, 0x1234, 0x56789abcdef1));

/* Button press characteristic value */
static uint8_t button_press_value = 0;

/**
 * @brief Write callback for button press characteristic
 */
static ssize_t write_button_press(struct bt_conn *conn, const struct bt_gatt_attr *attr,
                                   const void *buf, uint16_t len, uint16_t offset, uint8_t flags)
{
    ARG_UNUSED(conn);
    ARG_UNUSED(attr);
    ARG_UNUSED(flags);
    
    if (offset + len > sizeof(button_press_value)) {
        return BT_GATT_ERR(BT_ATT_ERR_INVALID_OFFSET);
    }
    
    if (len != sizeof(button_press_value)) {
        return BT_GATT_ERR(BT_ATT_ERR_INVALID_ATTRIBUTE_LEN);
    }
    
    uint8_t value = *((const uint8_t *)buf);
    
    if (value == 1) {
        /* Trigger button press - advance state machine */
        debug_printk("BLE: Button press received from master\n");
        main_state_machine_on_button_press();
    }
    
    button_press_value = value;
    
    return len;
}

/* GATT Service Definition */
BT_GATT_SERVICE_DEFINE(button_svc,
    BT_GATT_PRIMARY_SERVICE(&button_service_uuid),
    BT_GATT_CHARACTERISTIC(&button_press_uuid.uuid,
                           BT_GATT_CHRC_WRITE,
                           BT_GATT_PERM_WRITE,
                           NULL, write_button_press, &button_press_value),
);

/**
 * @brief Connection callback
 */
static void connected(struct bt_conn *conn, uint8_t err)
{
    char addr[BT_ADDR_LE_STR_LEN];
    
    bt_addr_le_to_str(bt_conn_get_dst(conn), addr, sizeof(addr));
    
    if (err) {
        debug_printk("BLE: Connection failed (err %u)\n", err);
    } else {
        debug_printk("BLE: Connected: %s\n", addr);
    }
}

/**
 * @brief Disconnection callback
 */
static void disconnected(struct bt_conn *conn, uint8_t reason)
{
    char addr[BT_ADDR_LE_STR_LEN];
    
    bt_addr_le_to_str(bt_conn_get_dst(conn), addr, sizeof(addr));
    debug_printk("BLE: Disconnected: %s (reason %u)\n", addr, reason);
}

BT_CONN_CB_DEFINE(conn_callbacks) = {
    .connected = connected,
    .disconnected = disconnected,
};

/* Advertising data with service UUID */
static const struct bt_data ad[] = {
    BT_DATA_BYTES(BT_DATA_FLAGS, (BT_LE_AD_GENERAL | BT_LE_AD_NO_BREDR)),
    BT_DATA_BYTES(BT_DATA_UUID128_ALL, BT_UUID_BUTTON_SERVICE_VAL),
};

/**
 * @brief Initialize BLE in slave mode
 */
int bluetooth_init(void)
{
    int err;
    
    err = bt_enable(NULL);
    if (err) {
        debug_printk("BLE: Enable failed (err %d)\n", err);
        return err;
    }
    
    debug_printk("BLE: Bluetooth initialized (slave mode)\n");
    
    /* Start advertising */
    err = bt_le_adv_start(
        BT_LE_ADV_PARAM(BT_LE_ADV_OPT_CONN,
                        BT_GAP_ADV_FAST_INT_MIN_2,
                        BT_GAP_ADV_FAST_INT_MAX_2,
                        NULL),
        ad, ARRAY_SIZE(ad), NULL, 0);
    
    if (err) {
        debug_printk("BLE: Advertising failed to start (err %d)\n", err);
        return err;
    }
    
    debug_printk("BLE: Advertising started\n");
    
    return 0;
}

#else
/* ========== MASTER MODE IMPLEMENTATION ========== */

#include <bluetooth/scan.h>

/* UUID definitions for master mode */
static struct bt_uuid_128 button_press_uuid = BT_UUID_INIT_128(
    BT_UUID_128_ENCODE(0x12345678, 0x1234, 0x5678, 0x1234, 0x56789abcdef1));

/* Connection state */
static struct bt_conn *active_conn = NULL;
static volatile bool connection_established = false;
static uint16_t button_press_handle = 0;
static bool handle_discovered = false;

/**
 * @brief Connection callback
 */
static void connected(struct bt_conn *conn, uint8_t err)
{
    char addr[BT_ADDR_LE_STR_LEN];
    
    bt_addr_le_to_str(bt_conn_get_dst(conn), addr, sizeof(addr));
    
    if (err) {
        debug_printk("BLE Master: Connection failed to %s (err %u)\n", addr, err);
        connection_established = false;
    } else {
        debug_printk("BLE Master: Connected: %s\n", addr);
        active_conn = bt_conn_ref(conn);
        connection_established = true;
        handle_discovered = false;
        button_press_handle = 0;
    }
}

/**
 * @brief Disconnection callback
 */
static void disconnected(struct bt_conn *conn, uint8_t reason)
{
    char addr[BT_ADDR_LE_STR_LEN];
    
    bt_addr_le_to_str(bt_conn_get_dst(conn), addr, sizeof(addr));
    debug_printk("BLE Master: Disconnected: %s (reason %u)\n", addr, reason);
    
    if (conn == active_conn) {
        bt_conn_unref(active_conn);
        active_conn = NULL;
    }
    
    connection_established = false;
    handle_discovered = false;
    button_press_handle = 0;
}

BT_CONN_CB_DEFINE(conn_callbacks) = {
    .connected = connected,
    .disconnected = disconnected,
};

/**
 * @brief Scan filter match callback
 */
static void scan_filter_match(struct bt_scan_device_info *device_info,
                               struct bt_scan_filter_match *filter_match, bool connectable)
{
    ARG_UNUSED(filter_match);
    
    char addr[BT_ADDR_LE_STR_LEN];
    
    bt_addr_le_to_str(device_info->recv_info->addr, addr, sizeof(addr));
    debug_printk("BLE Master: Filters matched. Address: %s connectable: %d\n", addr, connectable);
}

/**
 * @brief Scan connecting error callback
 */
static void scan_connecting_error(struct bt_scan_device_info *device_info)
{
    ARG_UNUSED(device_info);
    
    debug_printk("BLE Master: Connecting failed\n");
}

BT_SCAN_CB_INIT(scan_cb, scan_filter_match, NULL, scan_connecting_error, NULL);

/**
 * @brief GATT discovery callback
 */
static uint8_t discover_func(struct bt_conn *conn, const struct bt_gatt_attr *attr,
                              struct bt_gatt_discover_params *params)
{
    ARG_UNUSED(conn);
    
    if (!attr) {
        debug_printk("BLE Master: Discovery complete\n");
        (void)memset(params, 0, sizeof(*params));
        return BT_GATT_ITER_STOP;
    }
    
    if (params->type == BT_GATT_DISCOVER_CHARACTERISTIC) {
        const struct bt_gatt_chrc *chrc = (const struct bt_gatt_chrc *)attr->user_data;
        
        if (bt_uuid_cmp(chrc->uuid, &button_press_uuid.uuid) == 0) {
            button_press_handle = chrc->value_handle;
            handle_discovered = true;
            debug_printk("BLE Master: Found button press handle: %u\n", button_press_handle);
            (void)memset(params, 0, sizeof(*params));
            return BT_GATT_ITER_STOP;
        }
    }
    
    return BT_GATT_ITER_CONTINUE;
}

/**
 * @brief Discover button service and characteristic
 */
static int discover_button_service(void)
{
    if (handle_discovered) {
        return 0;
    }
    
    static struct bt_gatt_discover_params discover_params;
    
    handle_discovered = false;
    discover_params.uuid = &button_press_uuid.uuid;
    discover_params.func = discover_func;
    discover_params.start_handle = BT_ATT_FIRST_ATTRIBUTE_HANDLE;
    discover_params.end_handle = BT_ATT_LAST_ATTRIBUTE_HANDLE;
    discover_params.type = BT_GATT_DISCOVER_CHARACTERISTIC;
    
    int err = bt_gatt_discover(active_conn, &discover_params);
    if (err) {
        debug_printk("BLE Master: Characteristic discovery failed (err %d)\n", err);
        return err;
    }
    
    /* Wait for discovery by polling (like Nordic example) */
    uint32_t timeout = k_uptime_get_32() + 5000;
    while (!handle_discovered && k_uptime_get_32() < timeout) {
        k_yield();
    }
    
    if (!handle_discovered) {
        debug_printk("BLE Master: Characteristic discovery timeout\n");
        return -ETIMEDOUT;
    }
    
    return 0;
}

/**
 * @brief Start scanning for slave devices
 */
static void scan_start(void)
{
    int err;
    
    struct bt_le_scan_param scan_param = {
        .type = BT_LE_SCAN_TYPE_PASSIVE,
        .options = BT_LE_SCAN_OPT_FILTER_DUPLICATE,
        .interval = BT_GAP_SCAN_FAST_INTERVAL,
        .window = BT_GAP_SCAN_FAST_WINDOW,
    };
    
    struct bt_le_conn_param *conn_param =
        BT_LE_CONN_PARAM(BT_GAP_INIT_CONN_INT_MIN, BT_GAP_INIT_CONN_INT_MAX, 0, 400);
    
    struct bt_scan_init_param scan_init = {
        .connect_if_match = true,
        .scan_param = &scan_param,
        .conn_param = conn_param,
    };
    
    bt_scan_init(&scan_init);
    bt_scan_cb_register(&scan_cb);
    
    err = bt_scan_filter_add(BT_SCAN_FILTER_TYPE_UUID,
                             BT_UUID_DECLARE_128(BT_UUID_BUTTON_SERVICE_VAL));
    if (err) {
        debug_printk("BLE Master: Scan filter add failed (err %d)\n", err);
        return;
    }
    
    err = bt_scan_filter_enable(BT_SCAN_UUID_FILTER, false);
    if (err) {
        debug_printk("BLE Master: Scan filter enable failed (err %d)\n", err);
        return;
    }
    
    err = bt_scan_start(BT_SCAN_TYPE_SCAN_PASSIVE);
    if (err) {
        debug_printk("BLE Master: Scan start failed (err %d)\n", err);
        return;
    }
    
    debug_printk("BLE Master: Scanning started\n");
}

/**
 * @brief Initialize BLE in master mode
 */
int bluetooth_init(void)
{
    int err;
    
    err = bt_enable(NULL);
    if (err) {
        debug_printk("BLE Master: Enable failed (err %d)\n", err);
        return err;
    }
    
    debug_printk("BLE Master: Bluetooth initialized (master mode)\n");
    
    /* Start scanning */
    scan_start();
    
    /* Wait for connection (like Nordic example) */
    while (true) {
        if (connection_established) {
            debug_printk("BLE Master: Connection established\n");
            break;
        }
        k_yield();
    }
    
    /* Discover service */
    err = discover_button_service();
    if (err) {
        debug_printk("BLE Master: Service discovery failed (err %d)\n", err);
        return err;
    }
    
    debug_printk("BLE Master: Ready to send button presses\n");
    
    return 0;
}

/**
 * @brief Send button press to slave
 */
int bluetooth_master_send_button_press(void)
{
    if (!active_conn || !handle_discovered) {
        return -ENOTCONN;
    }
    
    uint8_t value = 1;
    
    int err = bt_gatt_write_without_response(active_conn, button_press_handle, &value, sizeof(value), false);
    if (err) {
        debug_printk("BLE Master: Write failed (err %d)\n", err);
        return err;
    }
    
    debug_printk("BLE Master: Button press sent to slave\n");
    return 0;
}

#endif /* BLE_MASTER */
#endif /* BLUETOOTH */
```

## src/button.c
```c
/*
 * Copyright (c) 2025 Matthias Dippold
 *
 * This program is free software: you can redistribute it and/or modify
 * it under the terms of the GNU General Public License as published by
 * the Free Software Foundation, either version 3 of the License, or
 * (at your option) any later version.
 *
 * This program is distributed in the hope that it will be useful,
 * but WITHOUT ANY WARRANTY; without even the implied warranty of
 * MERCHANTABILITY or FITNESS FOR A PARTICULAR PURPOSE.  See the
 * GNU General Public License for more details.
 *
 * You should have received a copy of the GNU General Public License
 * along with this program.  If not, see <https://www.gnu.org/licenses/>.
 *
 * NON-COMMERCIAL USE CLAUSE:
 * Permission is granted to use, copy, modify, and distribute this software
 * and its derivatives for NON-COMMERCIAL purposes only. Commercial use of
 * this software, in whole or in part, is strictly prohibited without
 * explicit written permission from the copyright holder.
 */

#include <zephyr/kernel.h>
#include <zephyr/drivers/gpio.h>
#include <zephyr/devicetree.h>

#include "button.h"
#include "utils.h"

/* GPIO Button Devicetree Specifications */
#define SW0_NODE DT_ALIAS(sw0)

static const struct gpio_dt_spec button = GPIO_DT_SPEC_GET_OR(SW0_NODE, gpios, {0});
static struct gpio_callback button_cb_data;

static button_event_handler_t user_cb;
static bool initialized = false;
static uint32_t last_event_time = 0;
static uint32_t current_time = 0;

#define DEBOUNCE_MS 200  /* Minimum time between button events to filter bounce */

/* Long press detection state */
static struct k_timer long_press_timer;
static uint8_t press_counter = 0;
static bool timer_active = false;
static struct k_work button_work;
static enum button_press_type pending_press_type;

static void button_work_handler(struct k_work *work)
{
    ARG_UNUSED(work);

    if (!initialized || !user_cb) {
        return;
    }

    user_cb(pending_press_type);
}

/**
 * @brief Timer expiry callback for long press detection
 * 
 * Periodically samples the button state every 100ms.
 * If button is released before 1s (counter > 10), triggers short press callback.
 * If button is still pressed after 1s (counter > 10), triggers long press callback.
 */
static void long_press_timer_handler(struct k_timer *timer)
{
    ARG_UNUSED(timer);
    
    if (!initialized || !user_cb || !timer_active) {
        return;
    }
    
    /* Read current button state */
    int val = gpio_pin_get_dt(&button);
    if (val < 0) {
        debug_printk("Error reading button state during sampling: %d\n", val);
        /* Continue sampling anyway */
        return;
    }
    
    /* val == 1 means pressed, DT handles active low / active high differentiation */
    if (val != 1) {
        /* Button released - short press detected */
        k_timer_stop(&long_press_timer);
        timer_active = false;
        press_counter = 0;
        
        debug_printk("Button released - short press detected\n");
        pending_press_type = BUTTON_PRESS_SHORT;
        k_work_submit(&button_work);
    } else {
        /* Button still pressed - increment counter */
        press_counter++;
        debug_printk("Button still pressed - counter: %u\n", press_counter);
        
        if (press_counter > 10) {
            /* Long press confirmed (1s elapsed) */
            k_timer_stop(&long_press_timer);
            timer_active = false;
            press_counter = 0;
            
            debug_printk("Long press confirmed after %u samples\n", press_counter);
            pending_press_type = BUTTON_PRESS_LONG;
            k_work_submit(&button_work);
        }
        /* Timer will auto-repeat every 100ms if still active */
    }
}

/**
 * @brief GPIO interrupt callback for button press/release
 * 
 * Called when button is pressed (falling edge for active-low button).
 * Starts periodic timer to detect short vs long press.
 */
static void button_pressed(const struct device *dev, struct gpio_callback *cb, uint32_t pins)
{
    ARG_UNUSED(dev);
    ARG_UNUSED(cb);
    ARG_UNUSED(pins);
    
    if (!initialized || !user_cb) {
        return;
    }
    
    current_time = k_uptime_get_32();
    /* Debounce: ignore events that occur too quickly after the last one */
    if (current_time - last_event_time < DEBOUNCE_MS) {
        debug_printk("Debouncing: ignoring event %u ms after last event\n", 
                     current_time - last_event_time);
        return;
    }
    
    /* Update last event time for debouncing */
    last_event_time = current_time;
    
    /* Cancel any existing timer (if previous press wasn't handled) */
    if (timer_active) {
        k_timer_stop(&long_press_timer);
        timer_active = false;
    }
    
    /* Reset counter and start periodic sampling timer */
    press_counter = 0;
    timer_active = true;
    k_timer_start(&long_press_timer, K_MSEC(100), K_MSEC(100));
    
    debug_printk("Button pressed - starting long press detection timer\n");
}

/**
 * @brief Initialize GPIO button with interrupt
 * 
 * Configures the button GPIO pin and sets up interrupt for state changes.
 * 
 * @param handler Function to call when button event is detected
 * @return 0 on success, negative error code on failure
 */
int button_init(button_event_handler_t handler)
{
    int err;

    if (!handler) {
        return -EINVAL;
    }

    user_cb = handler;
    k_work_init(&button_work, button_work_handler);

    /* Check if GPIO device is ready */
    if (!gpio_is_ready_dt(&button)) {
        debug_printk("Button GPIO device %s is not ready\n", button.port->name);
        return -EIO;
    }

    /* Configure button pin as input with pull-up (active low is set in device tree) */
    err = gpio_pin_configure_dt(&button, GPIO_INPUT | GPIO_PULL_UP);
    if (err < 0) {
        debug_printk("Error %d: failed to configure %s pin %d\n", 
                     err, button.port->name, button.pin);
        return err;
    }

    /* Mark as initialized - interrupts will be enabled later */
    initialized = true;
    
    debug_printk("GPIO button configured successfully on %s pin %d (interrupts not yet enabled)\n", 
                 button.port->name, button.pin);
    
    return 0;
}

/**
 * @brief Enable button interrupts after initialization
 * 
 * Should be called after all slow initialization tasks (e.g., I2C scanning)
 * to avoid spurious interrupts during boot/wake-up.
 * 
 * @return 0 on success, negative error code on failure
 */
int button_enable_interrupts(void)
{
    int err;
    
    if (!initialized) {
        debug_printk("Button not initialized, call button_init() first\n");
        return -EINVAL;
    }
    
    /* Check if GPIO device is ready */
    if (!gpio_is_ready_dt(&button)) {
        debug_printk("Button GPIO device %s is not ready\n", button.port->name);
        return -EIO;
    }
    
    /* Clear any pending interrupts by disabling and re-enabling */
    debug_printk("Clearing pending interrupts...\n");
    err = gpio_pin_interrupt_configure_dt(&button, GPIO_INT_DISABLE);
    if (err < 0) {
        debug_printk("Error %d: failed to disable interrupt on %s pin %d\n", 
                     err, button.port->name, button.pin);
        return err;
    }
    
    /* Small delay for hardware to settle */
    k_msleep(10);
    
    /* Initialize long press detection timer */
    k_timer_init(&long_press_timer, long_press_timer_handler, NULL);
    timer_active = false;
    press_counter = 0;
    
    /* Re-enable interrupt on falling edge (button press for active-low) */
    err = gpio_pin_interrupt_configure_dt(&button, GPIO_INT_EDGE_FALLING);
    if (err < 0) {
        debug_printk("Error %d: failed to configure interrupt on %s pin %d\n", 
                     err, button.port->name, button.pin);
        return err;
    }

    /* Initialize and add callback */
    gpio_init_callback(&button_cb_data, button_pressed, BIT(button.pin));
    gpio_add_callback(button.port, &button_cb_data);
    
    /* Initialize last event time */
    last_event_time = k_uptime_get_32();
    
    debug_printk("Button interrupts enabled successfully on %s pin %d\n", 
                 button.port->name, button.pin);
    
    return 0;
}

/**
 * @brief Configure button as wakeup source for system off mode
 * 
 * Reconfigures the button interrupt to use level-active triggering,
 * which is required to wake the system from system off (deep sleep).
 * 
 * @return 0 on success, negative error code on failure
 */
int button_configure_wakeup(void)
{
    int err;
    
    if (!initialized) {
        debug_printk("Button not initialized, cannot configure for wakeup\n");
        return -EINVAL;
    }
    
    /* Check if GPIO device is ready */
    if (!gpio_is_ready_dt(&button)) {
        debug_printk("Button GPIO device %s is not ready\n", button.port->name);
        return -EIO;
    }
    
    /* Configure interrupt as level-active to wake from system off */
    err = gpio_pin_interrupt_configure_dt(&button, GPIO_INT_LEVEL_ACTIVE);
    if (err < 0) {
        debug_printk("Error %d: failed to configure wakeup interrupt on %s pin %d\n", 
                     err, button.port->name, button.pin);
        return err;
    }
    
    debug_printk("Button configured as wakeup source (level-active interrupt)\n");
    
    return 0;
}
```

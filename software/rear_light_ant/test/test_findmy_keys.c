/*
 * Host test of the on-device Find My key schedule (ADR-0012).
 * Build and run with: make test
 *
 * Expected values come from FindMy.py (tools/haystack/.venv, findmy 0.10.x)
 * for a made-up accessory, never a real one:
 *   master_key = sha256(b"test master")[:28], skn = sha256(b"test skn")
 *   P0         = master_key * G   (cryptography, SECP224R1)
 *   sk_i       = acc._primary_gen._get_sk(i)
 *   adv_i      = acc._primary_key_at(i).adv_key_bytes
 * and for the backup chain, sks = sha256(b"test sks"):
 *   sks_j      = acc._secondary_gen._get_sk(j)
 *   sadv_j     = acc._secondary_gen[j].adv_key_bytes
 *   acc._secondary_keys_at(1000) = (sadv_11, sadv_12)
 */

#include <stdio.h>
#include <string.h>

#include "../src/findmy_keys.h"

static int failures;

#define CHECK(cond)                                                          \
    do {                                                                     \
        if (!(cond)) {                                                       \
            printf("FAIL %s:%d: %s\n", __FILE__, __LINE__, #cond);           \
            failures++;                                                      \
        }                                                                    \
    } while (0)

static const uint8_t master[FINDMY_MASTER_LEN] = {
    0x36, 0x80, 0xbc, 0x98, 0x71, 0xf3, 0x5c, 0xd1, 0x39, 0x34, 0x6f, 0x6a, 0x85, 0x89,
    0xea, 0xc0, 0x50, 0xdf, 0x31, 0x9b, 0x47, 0xf2, 0x88, 0x94, 0xb5, 0x5e, 0xa6, 0xe8,
    0x27, 0x81, 0xd5, 0xb6, 0xd3, 0xb7, 0xe6, 0xa2, 0x2a, 0xd5, 0x10, 0xd7, 0x44, 0xd1,
    0x43, 0xca, 0x6b, 0x17, 0xe3, 0xf2, 0x99, 0xc0, 0x70, 0x3e, 0xb2, 0x3c, 0x44, 0x4e,
};

static const uint8_t skn[FINDMY_SK_LEN] = {
    0xa1, 0xff, 0x33, 0x73, 0x5e, 0x69, 0xcd, 0xb7, 0xa4, 0xe9, 0x3c, 0x24, 0x5f, 0xe2, 0x29, 0x12,
    0x6d, 0x41, 0x6c, 0x0a, 0x2d, 0xe1, 0xc9, 0xda, 0x2a, 0x80, 0x02, 0x91, 0x7f, 0x09, 0xbd, 0x78,
};

static const uint8_t want_sk1000[FINDMY_SK_LEN] = {
    0x74, 0xec, 0xf9, 0xee, 0x56, 0xd5, 0x5f, 0xbe, 0x43, 0xe6, 0xff, 0x80, 0xe9, 0xa1, 0xc5, 0x3b,
    0x41, 0xab, 0xce, 0xe4, 0xd9, 0xb3, 0x0a, 0xcb, 0x15, 0x1d, 0x03, 0xd1, 0x12, 0xf9, 0x21, 0x0e,
};

static const uint8_t want_adv[4][FINDMY_ADV_KEY_LEN] = {
    { 0x86, 0x34, 0x8f, 0xcd, 0x15, 0x95, 0x95, 0xda, 0x04, 0x94, 0x57, 0xdf, 0x75, 0xb0,
      0x9f, 0x9b, 0x7b, 0x2a, 0x33, 0x47, 0x96, 0x91, 0xb4, 0xd4, 0x45, 0x73, 0xaa, 0x76 },
    { 0xcb, 0x51, 0x0e, 0xe6, 0x73, 0x1c, 0x63, 0x69, 0x23, 0x11, 0x4c, 0xd4, 0x38, 0xa2,
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      0xd0, 0x13, 0x27, 0x1b, 0x8d, 0x3d, 0x7b, 0x9c, 0xf0, 0x9a, 0xf5, 0xc2, 0x2c, 0xa3 },
};

static const uint8_t want_adv1000[FINDMY_ADV_KEY_LEN] = {
    0xff, 0x6b, 0xed, 0x3b, 0xb9, 0x7d, 0x53, 0x05, 0xbc, 0xee, 0x4f, 0x5e, 0x70, 0x27,
    0xb1, 0x02, 0xd8, 0xee, 0xba, 0x88, 0xb0, 0x43, 0x4d, 0xc3, 0x73, 0x54, 0x98, 0x22,
};

static const uint8_t sks[FINDMY_SK_LEN] = {
    0xa7, 0x9b, 0x36, 0x0c, 0x4f, 0xf3, 0xe2, 0x61, 0x83, 0x35, 0x8a, 0x37, 0xd0, 0x9a, 0xbe, 0xa1,
    0xa0, 0x00, 0xcd, 0x49, 0xaf, 0x07, 0x3f, 0x68, 0xa3, 0xb6, 0x3d, 0x9a, 0x04, 0x95, 0x1f, 0x48,
};

static const uint8_t want_sks1[FINDMY_SK_LEN] = {
    0xd0, 0xe7, 0x4a, 0xcb, 0x5c, 0x38, 0x33, 0xed, 0xc1, 0x4f, 0x69, 0xe7, 0x75, 0x47, 0x4b, 0x60,
    0xe5, 0xe7, 0x00, 0xe7, 0xb0, 0xdb, 0x7f, 0x53, 0xd7, 0x2a, 0xc6, 0x3d, 0xa5, 0xea, 0xf3, 0xb5,
};

static const uint8_t want_sadv1[FINDMY_ADV_KEY_LEN] = {
    0xc8, 0x0c, 0xdd, 0xbc, 0xd6, 0xd0, 0xe2, 0xea, 0xff, 0x14, 0x37, 0x0e, 0x27, 0xa7,
    0xf8, 0xdb, 0x98, 0xf0, 0xe0, 0x41, 0x60, 0xcc, 0x74, 0x85, 0xc1, 0xac, 0xe3, 0x00,
};

static const uint8_t want_sadv11[FINDMY_ADV_KEY_LEN] = {
    0x1a, 0x1b, 0x7c, 0x22, 0xed, 0x2e, 0xaf, 0x8c, 0x1c, 0x1e, 0x75, 0x73, 0x50, 0x62,
    0xe8, 0x3f, 0x8a, 0x11, 0x1c, 0x32, 0x28, 0x88, 0x3f, 0x01, 0xc4, 0x4c, 0x74, 0x63,
};

int main(void)
{
    uint8_t sk[FINDMY_SK_LEN];
    uint8_t adv[FINDMY_ADV_KEY_LEN];
    uint32_t i;

    /* Indices 0..3: SK_0 is SKN itself, each step one "update" */
    memcpy(sk, skn, sizeof(sk));
    for (i = 0U; i < 4U; i++) {
        CHECK(findmy_adv_key(master, sk, adv));
        CHECK(memcmp(adv, want_adv[i], sizeof(adv)) == 0);
        findmy_next_sk(sk, sk); /* in place, as the firmware does */
    }

    /* A long chain stays on track */
    for (; i < 1000U; i++) {
        findmy_next_sk(sk, sk);
    }
    CHECK(memcmp(sk, want_sk1000, sizeof(sk)) == 0);
    CHECK(findmy_adv_key(master, sk, adv));
    CHECK(memcmp(adv, want_adv1000, sizeof(adv)) == 0);

    /* Backup chain: same functions, started from SKS */
    memcpy(sk, sks, sizeof(sk));
    findmy_next_sk(sk, sk);
    CHECK(memcmp(sk, want_sks1, sizeof(sk)) == 0);
    CHECK(findmy_adv_key(master, sk, adv));
    CHECK(memcmp(adv, want_sadv1, sizeof(adv)) == 0);
    for (i = 1U; i < 11U; i++) {
        findmy_next_sk(sk, sk);
    }
    CHECK(findmy_adv_key(master, sk, adv));
    CHECK(memcmp(adv, want_sadv11, sizeof(adv)) == 0);

    /* Index mapping: the lower of FindMy.py's two candidates */
    CHECK(findmy_secondary_index(1000U) == 11U);
    CHECK(findmy_secondary_index(0U) == 1U);
    CHECK(findmy_secondary_index(95U) == 1U);
    CHECK(findmy_secondary_index(96U) == 2U);

    /* A master that is not on the curve is refused and leaves adv alone */
    {
        uint8_t bad[FINDMY_MASTER_LEN];

        memcpy(bad, master, sizeof(bad));
        bad[FINDMY_MASTER_LEN - 1U] ^= 0x01U;
        memset(adv, 0x5A, sizeof(adv));
        CHECK(!findmy_adv_key(bad, sk, adv));
        CHECK(adv[0] == 0x5AU && adv[FINDMY_ADV_KEY_LEN - 1U] == 0x5AU);
    }

    if (failures != 0) {
        printf("test_findmy_keys: %d failure(s)\n", failures);
        return 1;
    }
    printf("test_findmy_keys: all passed\n");
    return 0;
}
